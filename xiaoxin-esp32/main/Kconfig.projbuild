## xiaoxin-esp32/main/Kconfig.projbuild
```kconfig
menu "Xiaoxin Assistant"

config OTA_VERSION_URL
    string "OTA Version URL"
    default "https://yuanapi.wkyuan.com/django/api/ota/"
    help
        The application will access this URL to check for updates.


choice
    prompt "语言选择"
    default LANGUAGE_ZH_CN
    help
        Select device display language

    config LANGUAGE_ZH_CN
        bool "Chinese"
    config LANGUAGE_ZH_TW
        bool "Chinese Traditional"
    config LANGUAGE_EN_US
        bool "English"
    config LANGUAGE_JA_JP
        bool "Japanese"
endchoice


choice CONNECTION_TYPE
    prompt "Connection Type"
    default CONNECTION_TYPE_WEBSOCKET
    help
        网络数据传输协议
    config CONNECTION_TYPE_MQTT_UDP
        bool "MQTT + UDP"
    config CONNECTION_TYPE_WEBSOCKET
        bool "Websocket"
endchoice

config WEBSOCKET_URL
    depends on CONNECTION_TYPE_WEBSOCKET
    string "Websocket URL"
    default "ws://api.wkyuan.com:9013/xiaozhi/ws"
    help
        Communication with the server through websocket after wake up.

config WEBSOCKET_ACCESS_TOKEN
    depends on CONNECTION_TYPE_WEBSOCKET
    string "Websocket Access Token"
    default "test-token"
    help
        Access token for websocket communication.

choice BOARD_TYPE
    prompt "Board Type"
    default BOARD_TYPE_XIAOXIN_ESP32S3_096
    help
        Board type. 开发板类型
    config BOARD_TYPE_XIAOXIN_ESP32S3
         bool "xiaoxin_esp32s3"
    config BOARD_TYPE_XIAOXIN_ESP32S3_TOUCH
        bool "xiaoxin_esp32s3_touch"
    config BOARD_TYPE_XIAOXIN_ESP32S3_096
        bool "xiaoxin_esp32s3_096"
    config BOARD_TYPE_XIAOXIN_ESP32S3_028
        bool "xiaoxin_esp32s3_028"
    config BOARD_TYPE_XIAOXIN_ESP32S3_154
        bool "xiaoxin_esp32s3_154"
    config BOARD_TYPE_XIAOXIN_ESP32S3_4G
        bool "xiaoxin_esp32s3_4G"
    config BOARD_TYPE_xiaoxin_zhi
        bool "xiaoxin_zhi"
endchoice




config USE_WECHAT_MESSAGE_STYLE
    bool "使用微信聊天界面风格"
    default n
    help
        使用微信聊天界面风格

config USE_WAKE_WORD_DETECT
    bool "启用唤醒词检测"
    default y
    depends on IDF_TARGET_ESP32S3 && SPIRAM
    help
        需要 ESP32 S3 与 AFE 支持

config USE_AUDIO_PROCESSOR
    bool "启用音频降噪、增益处理"
    default y
    depends on IDF_TARGET_ESP32S3 && SPIRAM
    help
        需要 ESP32 S3 与 AFE 支持
config USE_REALTIME_CHAT
    bool "启用可语音打断的实时对话模式（需要 AEC 支持）"
    default n
    depends on USE_AUDIO_PROCESSOR && (BOARD_TYPE_BREAD_COMPACT_WIFI || BOARD_TYPE_ESP_BOX_3 || BOARD_TYPE_ESP_BOX || BOARD_TYPE_ESP_BOX_LITE || BOARD_TYPE_LICHUANG_DEV || BOARD_TYPE_ESP32S3_KORVO2_V3 || BOARD_TYPE_xiaoxin_zhi)
    help
        需要 ESP32 S3 与 AEC 开启，因为性能不够，不建议和微信聊天界面风格同时开启
                
        
        
endmenu
```
